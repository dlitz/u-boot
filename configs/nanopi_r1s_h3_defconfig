## configs/nanopi_r1s_h3_defconfig
```kconfig
CONFIG_ARM=y
CONFIG_ARCH_SUNXI=y
CONFIG_DEFAULT_DEVICE_TREE="sun8i-h3-nanopi-r1s"
CONFIG_SPL=y
CONFIG_IDENT_STRING=" NanoPi-R1S-H3"
CONFIG_MACH_SUN8I_H3=y
CONFIG_DRAM_CLK=408
CONFIG_MACPWR="PD6"
CONFIG_USB0_ID_DET="PG12"
# CONFIG_SYS_MALLOC_CLEAR_ON_INIT is not set
CONFIG_SPL_STACK=0x8000
CONFIG_SYS_PBSIZE=1024
CONFIG_CMD_USB_MASS_STORAGE=y
CONFIG_CMD_UMS_ABORT_KEYED=y
CONFIG_LED=y
CONFIG_LED_GPIO=y
CONFIG_SUN8I_EMAC=y
CONFIG_USB_EHCI_HCD=y
CONFIG_USB_OHCI_HCD=y
CONFIG_USB_MUSB_GADGET=y
#CONFIG_USB_HOST_ETHER=y
CONFIG_USB_ETHER_RTL8152=y
CONFIG_USB_GADGET_MANUFACTURER="FriendlyElec"
CONFIG_USB_GADGET_VBUS_DRAW=500
CONFIG_USB_FUNCTION_ACM=y


#CONFIG_CMD_CLK=y
#CONFIG_CMD_EEPROM=y
#CONFIG_CMD_I2C=y
#CONFIG_CMD_SF=y
#CONFIG_CMD_SPI=y
#CONFIG_DEFAULT_SPI_BUS=0
#CONFIG_DEFAULT_SPI_MODE=0
#
#
#CONFIG_CMD_MD5SUM=y
#CONFIG_MD5SUM_VERIFY=y
#CONFIG_SPI_FLASH_USE_4K_SECTORS=y

CONFIG_CMD_SF=y
#CONFIG_SPI=y
#CONFIG_SPI_FLASH=y
CONFIG_SPI_SUNXI=y
CONFIG_SPI_FLASH_MACRONIX=y
#CONFIG_DM_SPI=y
#CONFIG_DM_SPI_FLASH=y
#
CONFIG_SPL_SPI_SUNXI=y

CONFIG_USB_GADGET=y
CONFIG_USB_GADGET_DOWNLOAD=y
CONFIG_USB_FUNCTION_MASS_STORAGE=y

#### CONFIG_DISPLAY is not set
#### CONFIG_DM_VIDEO is not set
#### CONFIG_VIDEO is not set
#### CONFIG_VIDEO_DE2 is not set
#### CONFIG VIDEO_DT_SIMPLEFB is not set

CONFIG_CMD_BOOTDEV=y
CONFIG_CMD_BOOTMETH=y
CONFIG_CMD_SDRAM=y
# CONFIG_FIT_BEST_MATCH=y
CONFIG_FIT_VERBOSE=y
CONFIG_BOOTFLOW_FULL=y
CONFIG_BOOTSTD_FULL=y
CONFIG_BOOTSTD_BOOTCOMMAND=y
CONFIG_BOOTMETH_SCRIPT=y

#CONFIG_BOOTARGS_SUBST=y

CONFIG_LOGLEVEL=9
CONFIG_SPL_LOGLEVEL=9
```
